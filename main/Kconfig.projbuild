## main/Kconfig.projbuild
```kconfig
menu "Carviston"

config CARVISTON_MATTER_ENABLE
    bool "Enable Matter over WiFi (Water Heater profile)"
    default y
    help
      When enabled, the firmware brings up the Matter stack on a Water
      Heater node with OnOff, Thermostat and TemperatureMeasurement
      clusters bridged to the heater_control public API.

      Default is ON. Pulling esp-matter into the build is a heavy
      operation — it adds ~1.8 MB of code and the first-time build pulls
      ~500 MB of chip-project source. To build, the esp-matter SDK must
      be installed and sourced alongside ESP-IDF (see docs/MATTER.md).

      Before flashing a production unit you also need factory data
      (DAC + CD) provisioned into the matter_fac partition — see
      docs/MATTER.md. The firmware boots fine without it for development,
      but commissioning will reject a controller's pairing attempt.

      Set this to n if you want a strictly-local build without Matter
      (no BLE, no esp-matter, ~1.8 MB smaller binary).

config CARVISTON_MATTER_VENDOR_NAME
    string "Vendor name (advertised over Matter)"
    default "Carviston"
    depends on CARVISTON_MATTER_ENABLE

config CARVISTON_MATTER_PRODUCT_NAME
    string "Product name (advertised over Matter)"
    default "Carviston Boiler Controller"
    depends on CARVISTON_MATTER_ENABLE

endmenu
```
